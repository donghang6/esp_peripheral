## components/peripheral/Kconfig
```kconfig
menu "Peripheral or Module"

    menu "spi bus config"

        config HSPI_HOST
            bool "select hspi"
            default 0
        config VSPI_HOST
            bool "select vspi"
            default 0
        config MISO_IO_NUM
            int "select miso_io_num"
            default 0
        config MOSI_IO_NUM
            int "select mosi_io_num"
            default 0   
        config SCLK_IO_NUM 
            int "sclk_io_num"
            default 0
        config QUADWP_IO_NUM 
            int "quadwp_io_num"   
            default -1
        config QUADHD_IO_NUM
            int "quadhd_io_num"
            default -1
        config MAX_TRANSFER_SZ
            int "max_transfer_sz"
            default 100
        config DMA_CHAN
            int "select dma chan"
            default 0

    menu "polling or interupt"
        depends on USE_SPI_OLED

        config POLLING_TRANSMIT
            bool "use polling to transmit data"
        config INTERRUPT_TRANSMIT
            bool "use interupt to transmit data"
            
    endmenu # polling or interupt

    endmenu # spi bus config

    menuconfig USE_SPI_OLED
        bool "spi oled"

    menu "select gpio"
        depends on USE_SPI_OLED

        config IO_RES
            int "select IO_RES"
            default 0

        config IO_DC
            int "select IO_DC"
            default 0

    endmenu # select gpio

    menu "spi device interface config"
        depends on USE_SPI_OLED
        
        config COMMAND_BITS 
            int "command_bits"
            default 0
        config ADDRESS_BITS
            int "address_bits"
            default 0
        config CLOCK_SPEED_HZ
            int "clock_speed_hz"
            default 1000000
        config MODE
            int "mode"
            default 0
        config SPICS_IO_NUM_OLED
            int "spics_io_num"
            default 0
        config QUEUE_SIZE
            int "queue_size"
            default 0
        config PRE_CB
            string "pre_cb"
            default "NULL"

    endmenu # spi device interface config

    menuconfig USE_SPI_W25QXX
        bool "spi w25qxx"

    menu "spi device interface config"
        depends on USE_SPI_W25QXX
        
        config COMMAND_BITS 
            int "command_bits"
            default 0
        config ADDRESS_BITS
            int "address_bits"
            default 0
        config CLOCK_SPEED_HZ
            int "clock_speed_hz"
            default 1000000
        config MODE
            int "mode"
            default 0
        config SPICS_IO_NUM_W25QXX
            int "spics_io_num"
            default 0
        config QUEUE_SIZE
            int "queue_size"
            default 0
        config PRE_CB
            string "pre_cb"
            default "NULL"

    endmenu # spi device interface config
endmenu # Peripheral
```
